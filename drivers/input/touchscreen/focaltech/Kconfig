## drivers/input/touchscreen/focaltech/Kconfig
```kconfig
#
# Focaltech Touchscreen driver configuration
#

config TOUCHSCREEN_FT5X06_FH
       bool "FocalTech touchscreens FH support."
       depends on TOUCHSCREEN_FT5X06
       help
         Say Y here if you need a ft5X06 touchscreen FH function.
	 else say N

config TOUCHSCREEN_FT5X06_GESTURE
       bool "FocalTech touchscreens gesture function"
       depends on TOUCHSCREEN_FT5X06
       help
         Say Y here if you need a ft5X06 touchscreen gesture function.
	 else say N

config TOUCHSCREEN_FT5X06_GESTURE_DRIVER
       bool "FocalTech touchscreens gesture function realized in driver"
       depends on TOUCHSCREEN_FT5X06_GESTURE
       help
         Say Y here if you need a ft5X06 touchscreen gesture function in driver.
	 else say N

config TOUCHSCREEN_FACE_DETECTION
       bool "FocalTech touchscreens face detection function realized in driver"
       depends on TOUCHSCREEN_FT5X06
       help
         Say Y here if you need a ft5X06 touchscreen gesture function in driver.
	 else say N
```

## drivers/input/touchscreen/goodix/Kconfig
```kconfig
#
# Goodix GT9xx Touchscreen driver
#
config TOUCHSCREEN_GT9XX_GESTURE
	tristate "Goodix GT9xx touchpanel for gesture"
	depends on TOUCHSCREEN_GT9XX
	default n
	help
	  This is application debug interface support for Goodix GT9xx
	  touchscreens.

	  Say Y here if you want to have a Android app debug interface
	  to your system.

	  If unsure, say N.
config TOUCHSCREEN_GT9XX_AUTO_UPDATE
	bool "Goodix GT9xx touchpanel auto update "
	depends on TOUCHSCREEN_GT9XX
	default n
	help
		Say Y here to enable Touchscreen factory test functions.
		
		If unsure, say N.
config TOUCHSCREEN_GT9XX_COMPATIBLE_MODE
	bool "Goodix GT9xx touchpanel GT9XXF mode"
	depends on TOUCHSCREEN_GT9XX
	default n
	help
		Say Y here to enable Touchscreen GT9XXF mode.
		
		If unsure, say N.
```

## drivers/input/touchscreen/gt1xx/Kconfig
```kconfig
#
# Goodix GT1x Touchscreen driver
#
config TOUCHSCREEN_GT1X_GESTURE
	tristate "Goodix GT1x touchpanel for gesture"
	depends on TOUCHSCREEN_GT1XX
	default n
	help
	  This is application debug interface support for Goodix GT9xx
	  touchscreens.

	  Say Y here if you want to have a Android app debug interface
	  to your system.

	  If unsure, say N.

config TOUCHSCREEN_GT1X_FH
	tristate "Goodix GT1x touchpanel for frequency hopping"
	depends on TOUCHSCREEN_GT1XX
	default n
	help
	  This is frequency hopping support for Goodix GT1x
```

## drivers/input/touchscreen/synaptics_dsx_v20/Kconfig
```kconfig
#
# Synaptics DSX touchscreen driver V20 configuration
#
menuconfig TOUCHSCREEN_SYNAPTICS_DSX_V20
	bool "Synaptics DSX touchscreen V20"
	default n
	help
	  Say Y here if you have a Synaptics DSX touchscreen connected
	  to your system.

	  If unsure, say N.

if TOUCHSCREEN_SYNAPTICS_DSX_V20

config TOUCHSCREEN_SYNAPTICS_DSX_I2C_V20
	tristate "Synaptics DSX I2C touchscreen V20"
	depends on I2C
	help
	  Say Y here if you have a Synaptics DSX I2C touchscreen
	  connected to your system.

	  If unsure, say N.

	  To compile this driver as a module, choose M here: the
	  module will be called synaptics_dsx_i2c.

config TOUCHSCREEN_SYNAPTICS_DSX_RMI_DEV_V20
	tristate "Synaptics DSX touchscreen char device V20"
	depends on TOUCHSCREEN_SYNAPTICS_DSX_I2C_V20
	help
	  Say Y here to enable support for direct register access for Synaptics DSX
	  touchscreens.

	  If unsure, say N.

	  To compile this driver as a module, choose M here: the
	  module will be called synaptics_dsx_rmi_dev.

config TOUCHSCREEN_SYNAPTICS_DSX_TEST_REPORTING_V20
	tristate "Synaptics DSX touchscreen test reporting V20"
	depends on TOUCHSCREEN_SYNAPTICS_DSX_I2C_V20
	help
	  Say Y here to enable support for test reporting for Synaptics DSX
	  touchscreens.

	  If unsure, say N.

	  To compile this driver as a module, choose M here: the
	  module will be called synaptics_dsx_test_reporting.

config TOUCHSCREEN_SYNAPTICS_DSX_FW_UPDATE_V20
	tristate "Synaptics I2C touchscreen firmware update V20"
	depends on TOUCHSCREEN_SYNAPTICS_DSX_I2C_V20
	help
	  This enables support for firmware update for Synaptics RMI4
	  touchscreens.

	  Say Y here if you have a Synaptics DSX I2C touchscreen
	  connected to your system.

	  If unsure, say N.

	  To compile this driver as a module, choose M here: the
	  module will be called synaptics_dsx_fw_update.

config TOUCHSCREEN_SYNAPTICS_GLOVE
	tristate "Synaptics DSX touchscreen glove function"
	depends on TOUCHSCREEN_SYNAPTICS_DSX_I2C_V20
	help
	  This enables support for glove for Synaptics DSX
	  touchscreens.
endif
```

## drivers/sensors/Kconfig
```kconfig
config SENSORS
	bool "Sensors Class Support"
	help
	  This option enables the sensor sysfs class in /sys/class/sensors.
	  You'll need this to do anything useful with sensorss. If unsure, say N.

if SENSORS
config HS_SNS_REGU
	tristate "Individual sensor power"
	default y
	depends on SENSORS
	help
	 Say y here if you want to use individual sensor power.
endif

config SENSORS_SSC
	bool "Enable Sensors Driver Support for SSC"
	help
	  Add support for sensors SSC driver.
	  This driver is used for exercising sensors use case,
	  time syncing with ADSP clock.
```

## drivers/soc/his/Kconfig
```kconfig
comment "product Infomation"
config MACH_HIS_SMARTPHONE
	bool "HIS SMARTPHONE"
	default n
	help
	  Support for the his samrtphone board.

config HIS_VENDOR_NAME
	depends on MACH_HIS_SMARTPHONE
	string "His vendor info"
	default ""
	help
	  The vendor name of product.

config HIS_PRODUCT_NAME
	depends on MACH_HIS_SMARTPHONE
	string "His product info"
	default ""
	help
	  The product name.

config HIS_BOOT_INFO
	bool "His Boot information"
	depends on MACH_HIS_SMARTPHONE
	default n
	help
	  The information of booting system.

config USB_CDROM_NAME
	string "USB CDROM Name"
	depends on MACH_HIS_SMARTPHONE
	default "HsMoCorp"
	help
	  his usb cdrom name .

config USB_OTG_DOUBLE_CHECK
	bool "check OTG ID from PM and CPU"
	depends on HISENSE_USB_FEATURE
	default n
	help
	  check OTG ID from PM and CPU.

config SUBSYS_ERR_REPORT
	bool "report subsystem failed event by uevent"
	default n
	help
	  Enable it when collect the subsystem state report
	  if unsure, say N

source "drivers/soc/his/rs_recorder/Kconfig"
```

## drivers/soc/his/rs_recorder/Kconfig
```kconfig
config RS_RECORDER_SUPPORT
	bool "support runtime state recoder"
	default n
	help
	  print error info to buffer when happen runtime error

config RS_RECORDER_ARCHIVE
	bool "support compress log dir to the db file"
	depends on RS_RECORDER_SUPPORT
	default n
	help
	  compress log dir to the db file, then delete the dir.

config SUPPORT_WARM_RESET
	bool "current platform support warm reset"
	depends on RS_RECORDER_SUPPORT
	default n
	help
	  If use platform support warm reset, then say Y,
	  or N.
```
