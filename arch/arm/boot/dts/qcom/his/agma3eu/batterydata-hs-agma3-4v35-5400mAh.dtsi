
qcom,2476909_hisense_bp1081_5400mah_averaged_masterslave_jun6th2016 {
	/* #2476909_Hisense_BP1081_5400mAh_averaged_MasterSlave_Jun6th2016*/
	qcom,max-voltage-uv = <4350000>;
	qcom,nom-batt-capacity-mah = <5400>;
	qcom,batt-id-kohm = <270>;
	qcom,battery-beta = <3380>;
	qcom,battery-type = "hs-agma3-4v35-5400mAh";
	qcom,chg-rslow-comp-c1 = <2230126>;
	qcom,chg-rslow-comp-c2 = <2095190>;
	qcom,chg-rs-to-rslow = <595236>;
	qcom,chg-rslow-comp-thr = <0x99>;
	qcom,checksum = <0x5E59>;
	qcom,gui-version = "PMI8950GUI - 2.0.0.16";
	qcom,fg-profile-data = [
		 E8 83 EC 7C 
		 D6 80 A3 76 
		 5C 83 2E 67 
		 CD 82 72 8D 
		 25 82 5B 99 
		 E8 B7 DA C3 
		 5C 0F 0E 88 
		 4D 7E C8 81 
		 2C 7C 48 83 
		 FA 71 5C 74 
		 6F 74 3C 82 
		 E0 99 15 BD 
		 07 CA 5F 0D 
		 1E 16 25 5A 
		 CE 6E DA FB 
		 24 3C E4 44 
		 36 3B 00 00 
		 94 46 BC 20 
		 B3 40 00 00 
		 00 00 00 00 
		 00 00 00 00 
		 1E 6A 65 68 
		 83 78 2B 8B 
		 80 76 71 71 
		 B8 72 AB 88 
		 FD 6D EC 68 
		 23 7E EF A1 
		 23 38 5B 8E 
		 5C A0 71 0C 
		 28 00 FF 36 
		 F0 11 30 03 
		 00 00 00 0C 
	];
};
