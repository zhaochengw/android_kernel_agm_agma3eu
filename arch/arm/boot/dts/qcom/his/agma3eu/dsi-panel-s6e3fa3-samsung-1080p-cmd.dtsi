/* Copyright (c) 2015, The Linux Foundation. All rights reserved.
 *
 * This program is free software; you can redistribute it and/or modify
 * it under the terms of the GNU General Public License version 2 and
 * only version 2 as published by the Free Software Foundation.
 *
 * This program is distributed in the hope that it will be useful,
 * but WITHOUT ANY WARRANTY; without even the implied warranty of
 * MERCHANTABILITY or FITNESS FOR A PARTICULAR PURPOSE.  See the
 * GNU General Public License for more details.
 */

&mdss_mdp {
	dsi_s6e3fa3_samsung_1080p_vid: qcom,mdss_dsi_s6e3fa3_samsung_1080p_cmd {
		qcom,mdss-dsi-panel-name = "samsung s6e3fa3 fhd";
		qcom,mdss-dsi-panel-controller = <&mdss_dsi0>;
		qcom,mdss-dsi-panel-type = "dsi_cmd_mode";
		qcom,mdss-dsi-panel-destination = "display_1";
		qcom,mdss-dsi-panel-framerate = <60>;
		qcom,mdss-dsi-virtual-channel-id = <0>;
		qcom,mdss-dsi-stream = <0>;
		qcom,mdss-dsi-panel-width = <1080>;
		qcom,mdss-dsi-panel-height = <1920>;
        qcom,mdss-pan-physical-width-dimension = <68>;
        qcom,mdss-pan-physical-height-dimension = <121>;		
		qcom,mdss-dsi-h-front-porch = <89>;
		qcom,mdss-dsi-h-back-porch = <89>;
		qcom,mdss-dsi-h-pulse-width = <32>;
		qcom,mdss-dsi-h-sync-skew = <0>;
		qcom,mdss-dsi-v-back-porch = <7>;
		qcom,mdss-dsi-v-front-porch = <7>;
		qcom,mdss-dsi-v-pulse-width = <2>;
		qcom,mdss-dsi-h-left-border = <0>;
		qcom,mdss-dsi-h-right-border = <0>;
		qcom,mdss-dsi-v-top-border = <0>;
		qcom,mdss-dsi-v-bottom-border = <0>;
		qcom,mdss-dsi-bpp = <24>;
		qcom,mdss-dsi-underflow-color = <0xff>;
		qcom,mdss-dsi-border-color = <0>;
		qcom,mdss-dsi-h-sync-pulse = <0>;
		qcom,mdss-dsi-traffic-mode = "burst_mode";
		qcom,mdss-dsi-bllp-eof-power-mode;
		qcom,mdss-dsi-bllp-power-mode;
		qcom,mdss-dsi-lane-0-state;
		qcom,mdss-dsi-lane-1-state;
		qcom,mdss-dsi-lane-2-state;
		qcom,mdss-dsi-lane-3-state;
		qcom,mdss-dsi-tx-eot-append;
		qcom,mdss-dsi-dma-trigger = "trigger_sw";
		qcom,mdss-dsi-mdp-trigger = "none";
		qcom,mdss-dsi-on-command = [
			05 01 00 00 14 00 02 11 00
			05 01 00 00 00 00 02 35 00
			39 01 00 00 00 00 03 FC 5A 5A
			15 01 00 00 00 00 02 B0 1E
			15 01 00 00 00 00 02 FD 9E
			39 01 00 00 00 00 03 FC A5 A5		
			15 01 00 00 00 00 02 53 28		
			15 01 00 00 50 00 02 51 00		
		    05 01 00 00 00 00 02 2C 00										
		    05 01 00 00 14 00 02 29 00
		];
		qcom,mdss-dsi-off-command = [05 01 00 00 0A 00 02 28 00
				 05 01 00 00 96 00 02 10 00];
		qcom,mdss-dsi-on-command-state = "dsi_lp_mode";
		qcom,mdss-dsi-off-command-state = "dsi_lp_mode";
		qcom,mdss-dsi-bl-min-level = <2>;
		qcom,mdss-dsi-bl-max-level = <255>;
		qcom,mdss-dsi-bl-pmic-control-type = "bl_ctrl_dcs";
		qcom,mdss-dsi-reset-sequence = <1 10>, <0 20>, <1 20>;
		qcom,mdss-dsi-te-pin-select = <1>;
		qcom,mdss-dsi-te-dcs-command = <1>;
		qcom,mdss-dsi-te-check-enable;
		qcom,mdss-dsi-te-using-te-pin;
		qcom,mdss-dsi-wr-mem-start = <0x2c>;
		qcom,mdss-dsi-wr-mem-continue = <0x3c>;			
    qcom,mdss-dsi-lp11-init;        
    qcom,mdss-dsi-panel-orientation = "180";
		qcom,mdss-dsi-bl-dcs-dimspeed-control;
		qcom,mdss-dsi-bl-dcs-dimspeed-high-command = [15 01 00 00 00 00 02 53 20];
		qcom,mdss-dsi-bl-dcs-dimspeed-low-command = [15 01 00 00 00 00 02 53 28];
        //qcom,mdss-dsi-panel-rotation-type = "framework";
		/*esd check
		qcom,esd-check-enabled;
		qcom,mdss-dsi-panel-status-command-state = "dsi_lp_mode";
		qcom,mdss-dsi-panel-status-check-mode = "reg_read";
		qcom,mdss-dsi-panel-esd-check-register = <0x0a>;
		qcom,mdss-dsi-panel-esd-check-register-value = <0x9c>;*/        
	};
};
