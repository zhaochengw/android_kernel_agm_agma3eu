/* Copyright (c) 2013, The Linux Foundation. All rights reserved.
 *
 * This program is free software; you can redistribute it and/or modify
 * it under the terms of the GNU General Public License version 2 and
 * only version 2 as published by the Free Software Foundation.
 *
 * This program is distributed in the hope that it will be useful,
 * but WITHOUT ANY WARRANTY; without even the implied warranty of
 * MERCHANTABILITY or FITNESS FOR A PARTICULAR PURPOSE.  See the
 * GNU General Public License for more details.
 */

/*---------------------------------------------------------------------------
 * This file is autogenerated file using gcdb parser. Please do not edit it.
 * Update input XML file to add a new entry or update variable in this file
 * VERSION = "1.0"
 *---------------------------------------------------------------------------*/
&mdss_mdp {
	dsi_otm1287a_booyi_720p_vid: qcom,mdss_dsi_otm1287a_booyi_720p_video {
		qcom,mdss-dsi-panel-name = "booyi otm1287a hd";
		qcom,mdss-dsi-panel-controller = <&mdss_dsi0>;
		qcom,mdss-dsi-panel-type = "dsi_video_mode";
		qcom,mdss-dsi-panel-destination = "display_1";
		qcom,mdss-dsi-panel-framerate = <60>;
		qcom,mdss-dsi-virtual-channel-id = <0>;
		qcom,mdss-dsi-stream = <0>;
		qcom,mdss-dsi-panel-width = <720>;
		qcom,mdss-dsi-panel-height = <1280>;
		qcom,mdss-dsi-h-front-porch = <156>;
		qcom,mdss-dsi-h-back-porch = <156>;
		qcom,mdss-dsi-h-pulse-width = <32>;
		qcom,mdss-dsi-h-sync-skew = <0>;
		qcom,mdss-dsi-v-back-porch = <12>;
		qcom,mdss-dsi-v-front-porch = <15>;
		qcom,mdss-dsi-v-pulse-width = <4>;
		qcom,mdss-dsi-h-left-border = <0>;
		qcom,mdss-dsi-h-right-border = <0>;
		qcom,mdss-dsi-v-top-border = <0>;
		qcom,mdss-dsi-v-bottom-border = <0>;
		qcom,mdss-dsi-bpp = <24>;
		qcom,mdss-dsi-underflow-color = <0xff>;
		qcom,mdss-dsi-border-color = <0>;
		qcom,mdss-dsi-on-command = [
			29 01 00 00 00 00 02 00 00
			29 01 00 00 00 00 04 ff 12 87 01	//EXTC=1
			29 01 00 00 00 00 02 00 80	        //Orise mode enable
			29 01 00 00 00 00 03 ff 12 87

			29 01 00 00 00 00 02 00 a6             //zigzag setting
			29 01 00 00 00 00 02 b3 0f

			//-------------------- panel setting --------------------//
			29 01 00 00 00 00 02 00 80             //TCON Setting
			29 01 00 00 00 00 0A c0 00 64 00 10 10 00 64 10 10

			29 01 00 00 00 00 02 00 90             //Panel Timing Setting
			29 01 00 00 00 00 07 c0 00 5c 00 01 00 04

			29 01 00 00 00 00 02 00 a2
			29 01 00 00 00 00 04 C0 01 00 00

			29 01 00 00 00 00 02 00 b3             //Interval Scan Frame: 0 frame  column inversion
			29 01 00 00 00 00 03 c0 00 55

			29 01 00 00 00 00 02 00 81             //frame rate:60Hz
			29 01 00 00 00 00 02 c1 55

			//-------------------- power setting --------------------//
			29 01 00 00 00 00 02 00 a0             //dcdc setting
			29 01 00 00 00 00 0F c4 05 10 04 02 05 15 11 05 10 07 02 05 15 11

			29 01 00 00 00 00 02 00 b0             //clamp voltage setting
			29 01 00 00 00 00 03 c4 00 00

			29 01 00 00 00 00 02 00 91             //VGH=15V  VGL=-12V  pump ratio:VGH=6x  VGL=-5x
			29 01 00 00 00 00 03 c5 49 52

			29 01 00 00 00 00 02 00 00             //GVDD=4.9V  NGVDD=-4.9V
			29 01 00 00 00 00 03 d8 be be             

			29 01 00 00 00 00 02 00 00 		         //VCOM=-1.15V           
			29 01 00 00 00 00 02 d9 4F        

            29 01 00 00 00 00 02 00 d0		       
			29 01 00 00 00 00 03 d9 aa aa			

			29 01 00 00 00 00 02 00 b3             //VDD_18V=1.7V  LVDSVDD=1.6V
			29 01 00 00 00 00 02 c5 84

			29 01 00 00 00 00 02 00 bb             //LVD voltage level setting
			29 01 00 00 00 00 02 c5 8a

			29 01 00 00 00 00 02 00 82		//chopper
			29 01 00 00 00 00 02 C4 0a

			29 01 00 00 00 00 02 00 c6		//debounce
			29 01 00 00 00 00 02 b0 03

			//-------------------- control setting --------------------//
			29 01 00 00 00 00 02 00 00             //ID1
			29 01 00 00 00 00 02 d0 40

			29 01 00 00 00 00 02 00 00             //ID2  ID3
			29 01 00 00 00 00 03 d1 00 00

			//-------------------- power on setting --------------------//
			29 01 00 00 00 00 02 00 80             //source blanking frame = black  defacult='30'
			29 01 00 00 00 00 02 c4 00

			29 01 00 00 00 00 02 00 98             //vcom discharge=gnd:'10'  '00'=disable
			29 01 00 00 00 00 02 c5 10

			29 01 00 00 00 00 02 00 81
			29 01 00 00 00 00 02 f5 15  // ibias off
			29 01 00 00 00 00 02 00 83 
			29 01 00 00 00 00 02 f5 15  // lvd off
			29 01 00 00 00 00 02 00 85
			29 01 00 00 00 00 02 f5 15  // gvdd off
			29 01 00 00 00 00 02 00 87 
			29 01 00 00 00 00 02 f5 15  // lvdsvdd off
			29 01 00 00 00 00 02 00 89
			29 01 00 00 00 00 02 f5 15  // nvdd_18 off
			29 01 00 00 00 00 02 00 8b 
			29 01 00 00 00 00 02 f5 15  // en_vcom off

			29 01 00 00 00 00 02 00 95
			29 01 00 00 00 00 02 f5 15  // pump3 off
			29 01 00 00 00 00 02 00 97 
			29 01 00 00 00 00 02 f5 15  // pump4 off
			29 01 00 00 00 00 02 00 99
			29 01 00 00 00 00 02 f5 15  // pump5 off

			29 01 00 00 00 00 02 00 a1 
			29 01 00 00 00 00 02 f5 15  // gamma off
			29 01 00 00 00 00 02 00 a3
			29 01 00 00 00 00 02 f5 15  // sd ibias off
			29 01 00 00 00 00 02 00 a5 
			29 01 00 00 00 00 02 f5 15  // sdpch off
			29 01 00 00 00 00 02 00 a7 
			29 01 00 00 00 00 02 f5 15  // sdpch bias off
			29 01 00 00 00 00 02 00 ab
			29 01 00 00 00 00 02 f5 18  // ddc osc off

			29 01 00 00 00 00 02 00 94             //VCL pump dis
			29 01 00 00 00 00 03 f5 00 00

			29 01 00 00 00 00 02 00 d2             //VCL reg. en
			29 01 00 00 00 00 03 f5 06 15

			29 01 00 00 00 00 02 00 b2             //VGLO1
			29 01 00 00 00 00 03 f5 00 00

			29 01 00 00 00 00 02 00 b6             //VGLO2
			29 01 00 00 00 00 03 f5 00 00

			29 01 00 00 00 00 02 00 b4             //VGLO1/2 Pull low setting
			29 01 00 00 00 00 02 c5 cc		//d[7] vglo1 d[6] vglo2 => 0: pull vss  1: pull vgl

			//-------------------- for Power IC ---------------------------------
			29 01 00 00 00 00 02 00 90             //Mode-3
			29 01 00 00 00 00 05 f5 02 11 02 15

			29 01 00 00 00 00 02 00 90             //2xVPNL  1.5*=00  2*=50  3*=a0
			29 01 00 00 00 00 02 c5 50

			29 01 00 00 00 00 02 00 94             //Frequency
			29 01 00 00 00 00 02 c5 66

			//-------------------- panel timing state control --------------------//
			29 01 00 00 00 00 02 00 80             //panel timing state control
			29 01 00 00 00 00 0C cb 00 00 00 00 00 00 00 00 00 00 00

			29 01 00 00 00 00 02 00 90             //panel timing state control
			29 01 00 00 00 00 10 cb 00 00 00 00 00 00 00 00 00 00 00 ff 00 ff 00

			29 01 00 00 00 00 02 00 a0             //panel timing state control
			29 01 00 00 00 00 10 cb ff 00 ff 00 00 00 00 00 00 00 00 00 00 00 00

			29 01 00 00 00 00 02 00 b0             //panel timing state control
			29 01 00 00 00 00 10 cb 00 00 00 ff 00 ff 00 ff 00 ff 00 00 00 00 00

			29 01 00 00 00 00 02 00 c0             //panel timing state control
			29 01 00 00 00 00 10 cb 00 00 00 00 00 00 00 05 05 00 05 05 05 05 05

			29 01 00 00 00 00 02 00 d0             //panel timing state control
			29 01 00 00 00 00 10 cb 05 05 05 05 05 00 00 00 00 00 00 00 00 00 05

			29 01 00 00 00 00 02 00 e0             //panel timing state control
			29 01 00 00 00 00 0f cb 05 00 05 05 05 05 05 05 05 05 05 05 00 00

			29 01 00 00 00 00 02 00 f0             //panel timing state control
			29 01 00 00 00 00 0C cb ff ff ff ff ff ff ff ff ff ff ff

			//-------------------- panel pad mapping control --------------------//
			29 01 00 00 00 00 02 00 80             //panel pad mapping control
			29 01 00 00 00 00 10 cc 00 00 00 00 00 00 00 05 07 00 0d 09 0f 0b 11

			29 01 00 00 00 00 02 00 90             //panel pad mapping control
			29 01 00 00 00 00 10 cc 15 13 17 01 03 00 00 00 00 00 00 00 00 00 06

			29 01 00 00 00 00 02 00 a0             //panel pad mapping control
			29 01 00 00 00 00 0F cc 08 00 0e 0a 10 0c 12 16 14 18 02 04 00 00

			29 01 00 00 00 00 02 00 b0             //panel pad mapping control
			29 01 00 00 00 00 10 cc 00 00 00 00 00 00 00 04 02 00 0c 10 0a 0e 14

			29 01 00 00 00 00 02 00 c0             //panel pad mapping control
			29 01 00 00 00 00 10 cc 18 12 16 08 06 00 00 00 00 00 00 00 00 00 03

			29 01 00 00 00 00 02 00 d0             //panel pad mapping control
			29 01 00 00 00 00 0F cc 01 00 0b 0f 09 0d 13 17 11 15 07 05 00 00

			//-------------------- panel timing setting --------------------//
			29 01 00 00 00 00 02 00 80             //panel VST setting
			29 01 00 00 00 00 0D ce 87 03 28 86 03 28 85 03 28 84 03 28

			29 01 00 00 00 00 02 00 90             //panel VEND setting
			29 01 00 00 00 00 0F ce 34 fc 28 34 fd 28 34 fe 28 34 ff 28 00 00

			29 01 00 00 00 00 02 00 a0             //panel CLKA1/2 setting
			29 01 00 00 00 00 0F ce 38 07 05 00 00 28 00 38 06 05 01 00 28 00

			29 01 00 00 00 00 02 00 b0             //panel CLKA3/4 setting
			29 01 00 00 00 00 0F ce 38 05 05 02 00 28 00 38 04 05 03 00 28 00

			29 01 00 00 00 00 02 00 c0             //panel CLKb1/2 setting
			29 01 00 00 00 00 0F ce 38 03 05 04 00 28 00 38 02 05 05 00 28 00

			29 01 00 00 00 00 02 00 d0             //panel CLKb3/4 setting
			29 01 00 00 00 00 0F ce 38 01 05 06 00 28 00 38 00 05 07 00 28 00

			29 01 00 00 00 00 02 00 80             //panel CLKc1/2 setting
			29 01 00 00 00 00 0F cf 38 07 05 00 00 18 25 38 06 05 01 00 18 25

			29 01 00 00 00 00 02 00 90             //panel CLKc3/4 setting
			29 01 00 00 00 00 0F cf 38 05 05 02 00 18 25 38 04 05 03 00 18 25

			29 01 00 00 00 00 02 00 a0             //panel CLKd1/2 setting
			29 01 00 00 00 00 0F cf 38 03 05 04 00 18 25 38 02 05 05 00 18 25

			29 01 00 00 00 00 02 00 b0             //panel CLKd3/4 setting
			29 01 00 00 00 00 0F cf 38 01 05 06 00 18 25 38 00 05 07 00 18 25

			29 01 00 00 00 00 02 00 c0             //panel ECLK setting
			29 01 00 00 00 00 0C cf 01 01 20 20 00 00 01 81 00 03 08

			//-------------------- gamma --------------------//
            29 01 00 00 00 00 02 00 00                                                                                  //                                                                             
			29 01 00 00 00 00 15 E1 
			08 18 21 2A 38 46 48 74 69 85 
			7C 64 73 4E 49 3C 2F 22 17 10 
			                                                                                
			29 01 00 00 00 00 02 00 00                                                                                                                                                           
			29 01 00 00 00 00 15 E2 
			08 18 21 2A 38 46 48 74 69 85 
			7C 64 73 4E 49 3C 2F 22 17 10 
            //-------------------- ce_skin1.3_gain1.6--------------------//	
            		29 01 00 00 00 00 02 81 81 //open ce cmd1 mid(81) 
			29 01 00 00 00 00 02 00 A0
			29 01 00 00 00 00 0D D6 01 4d 01 4d 01 73 01 9a 01 9a 01 9a
			29 01 00 00 00 00 02 00 B0
			29 01 00 00 00 00 0D D6 01 9a 01 9a 01 9a 01 9a 01 9a 01 9a
			29 01 00 00 00 00 02 00 C0
			29 01 00 00 00 00 0D D6 4d 11 33 66 11 66 66 11 66 66 11 66
			29 01 00 00 00 00 02 00 D0
			29 01 00 00 00 00 07 D6 66 11 66 66 11 66
			29 01 00 00 00 00 02 00 E0
			29 01 00 00 00 00 0D D6 33 11 33 33 11 33 33 11 33 33 11 33
			29 01 00 00 00 00 02 00 F0
			29 01 00 00 00 00 07 D6 33 11 33 33 11 33

			05 01 00 00 78 00 02 11 00	
				 			                
			05 01 00 00 14 00 02 29 00

			];
		qcom,mdss-dsi-color-enhance-1-on-command = [	
			29 01 00 00 00 00 02 81 80];  //CE-low
		qcom,mdss-dsi-color-enhance-2-on-command = [		
			29 01 00 00 00 00 02 81 81];  //CE-mid			
		qcom,mdss-dsi-color-enhance-3-on-command = [	
			29 01 00 00 00 00 02 81 83];  //CE-High
		qcom,mdss-dsi-color-enhance-register = <0x81>;
            qcom,mdss-dsi-off-command = [05 01 00 00 14 00 02 28 00
                05 01 00 00 78 00 02 10 00];
            qcom,mdss-dsi-on-command-state = "dsi_lp_mode";
            qcom,mdss-dsi-off-command-state = "dsi_lp_mode";
            qcom,mdss-dsi-h-sync-pulse = <0>;
            qcom,mdss-dsi-traffic-mode = "burst_mode";
            qcom,mdss-dsi-hfp-power-mode;
            qcom,mdss-dsi-hbp-power-mode;
            qcom,mdss-dsi-hsa-power-mode;
            qcom,mdss-dsi-bllp-eof-power-mode;
            qcom,mdss-dsi-bllp-power-mode;
            qcom,mdss-dsi-lane-0-state;
            qcom,mdss-dsi-lane-1-state;
            qcom,mdss-dsi-lane-2-state;
            qcom,mdss-dsi-lane-3-state;
            qcom,mdss-dsi-bl-min-level = <1>;
            qcom,mdss-dsi-bl-max-level = <4095>;
            qcom,mdss-dsi-dma-trigger = "trigger_sw";
            qcom,mdss-dsi-mdp-trigger = "none";
            qcom,mdss-dsi-bl-pmic-control-type = "bl_ctrl_wled";
	qcom,mdss-dsi-tx-eot-append;
            qcom,mdss-dsi-reset-sequence = <1 10>, <0 10>, <1 20>;
            qcom,mdss-dsi-lp11-init;
           // qcom,esd-check-enabled;
           // qcom,mdss-dsi-panel-status-command-state = "dsi_hs_mode";
           // qcom,mdss-dsi-panel-status-check-mode = "reg_read";
           // qcom,mdss-dsi-panel-esd-check-register = <0x0a>,<0x0b>,<0x0d>;
           // qcom,mdss-dsi-panel-esd-check-register-value = <0x9c>,<0x00>,<0x00>;
	};
};
